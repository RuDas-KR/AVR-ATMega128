#include<avr/io.h>
#include<util/delay.h>

int main() {
	int SEG[] = {0x3F, 0x06, 0x5B, 0x4F, 0x66, 0x6D, 0x7D, 0x27, 0x7F, 0x67, 0x77, 0x7C, 0x39,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 0x62, 0x4B};
	int i;

	PORTG=0x01;	// Segments 위치지정. 현재 맨 오른쪽만 사용
	DDRG=0xFF;	// FND 출력. 모두 출력 가능하도록 되어있다.
	DDRC=0xFF;	// FND 데이터. Segments의 모든 비트를 출력가능하도록.
	DDRE=0x0F;	// Switch를 사용할수 있도록. PE4, PE5를 사용할 수 있다.

	while(1)
	{
		if(PINE != 0x20)	//PINE값과 PE5값을 비교
		{
			for(i=0; i<36; i++) 
			{
				PORTC=SEG[i];
				_delay_ms(1000);
				if(PINE == 0x20) {break;}	//PINE값과 PE5값이 같으면 빠져나오도록 설정
			}
		}
		else
		{
			PORTC=SEG[i];
		}
	}
	
	return 0;
}
